#ifndef STORAGE_VERSION_ENTRY
#define STORAGE_VERSION_ENTRY(X)
#endif

#ifndef STORAGE_VERSION_LAST
#define STORAGE_VERSION_LAST(X) STORAGE_VERSION_ENTRY(X)
#endif

STORAGE_VERSION_ENTRY(1)
STORAGE_VERSION_ENTRY(2)
STORAGE_VERSION_ENTRY(3)
STORAGE_VERSION_ENTRY(4)
STORAGE_VERSION_ENTRY(5)
STORAGE_VERSION_ENTRY(6)
STORAGE_VERSION_ENTRY(7)
STORAGE_VERSION_ENTRY(8)
STORAGE_VERSION_ENTRY(9)
STORAGE_VERSION_ENTRY(10)
STORAGE_VERSION_ENTRY(11)
STORAGE_VERSION_ENTRY(12)
STORAGE_VERSION_ENTRY(13)
STORAGE_VERSION_ENTRY(14)
STORAGE_VERSION_ENTRY(15)
STORAGE_VERSION_ENTRY(16)
STORAGE_VERSION_LAST(17)


#undef STORAGE_VERSION_ENTRY
#undef STORAGE_VERSION_LAST
